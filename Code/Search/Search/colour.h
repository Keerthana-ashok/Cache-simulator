/***************************************************************************************************************************************
****************************************************************************************************************************************
 * Team ID:     eYRCPlus-SR#935
 * Author List:	Sanjay A C, Vikas H C, Keerthana A B, Sucharitha Bhat J S. 	  
 * Filename:	colour.h
 * Theme:		Search and Rescue
 * Functions:	color_sensor_pin_config,color_sensor_pin_interrupt_init,ISR(INT2_vect),colour_init,filter_red,filter_green,filter_blue,
				filter_clear,color_sensor_scaling,red_read,green_read,blue_read,no_filter,get_colour,display_colour
 * Global Variables:   	pulse,	(To store number of pulses read from colour sensor),
						red,	(To store the number of red pulses),
						blue,	(To store the number of blue pulses),
						green,	(To store the number of green pulses),
						no_ff	(To store the number of white pulses),
 * Connection of colour sensor:							
	*Vcc is connected on servo pod pin 7
	*Vdd is connected on servo pod pin 6
	*Output of the sensor is connected to PD2 (INT2) of Atmega 2560 i.e Pin 38 on expansion slot
	*S0 of the sensor is connected to PD4 of Atmega 2560 i.e Pin 25 on expansion slot
	*S1 of the sensor is connected to PD5 of Atmega 2560 i.e Pin 29 on expansion slot
	*S2 of the sensor is connected to PD6 of Atmega 2560 i.e Pin 33 on expansion slot
	*S3 of the sensor is connected to PD7 of Atmega 2560 i.e Pin 34 on expansion slot 
 * Connection of RGB LED:
	*	RED	pin		- pin 20 : PD0
	*	Green pin	- pin 19 : PD1
	*	Blue pin	- pin 37 : PD3
	*	Ground pin	- pin 23
 ***************************************************************************************************************************************
 ***************************************************************************************************************************************
 */

#ifndef COLOUR_H_
#define COLOUR_H_
#include <math.h> //included to support power function


volatile unsigned long int pulse = 0; //to keep the track of the number of pulses generated by the color sensor
volatile unsigned long int red;       // variable to store the pulse count when read_red function is called
volatile unsigned long int blue;      // variable to store the pulse count when read_blue function is called
volatile unsigned long int green;     // variable to store the pulse count when read_green function is called
volatile unsigned long int no_ff;     // variable to store the pulse count when no_filter function is called

/******************************************************************************************************************************
* Function Name: color_sensor_pin_config
* Input:		 none
* Output:		 none
* Logic:		 configure ports for colour sensor & RGB LED
* Example call:	 color_sensor_pin_config();
*******************************************************************************************************************************/

void color_sensor_pin_config(void)
{
	DDRD  = DDRD | 0xFB; //set PD0 as input for color sensor output
	PORTD = PORTD | 0x04;//Enable internal pull-up for PORTD 0 pin
}

void rgb_led_pin_config(void)
{
	DDRJ  = DDRJ | 0xFF;
	PORTJ = PORTJ | 0x00;
}

/******************************************************************************************************************************
* Function Name: color_sensor_pin_interrupt_init
* Input:		 none
* Output:		 none
* Logic:		 initialise interrupt pin for reading pulses from colour sensor
* Example call:	 color_sensor_pin_interrupt_init();
*******************************************************************************************************************************/

void color_sensor_pin_interrupt_init(void) //Interrupt 0 enable
{
	cli(); //Clears the global interrupt
	EICRA = EICRA | 0x20; // INT2 is set to trigger with falling edge
	//EIMSK = EIMSK | 0x04; // Enable Interrupt INT2 for color sensor
	sei(); // Enables the global interrupt
}

/******************************************************************************************************************************
* Function Name: ISR(INT2_vect)
* Input:		 interrupt pulses from colour sensor
* Output:		 none
* Logic:		 stores number of pulses read from colour sensor
* Example call:	 ISR(INT2_vect)
*******************************************************************************************************************************/
ISR(INT2_vect)
{
	pulse++; //increment on receiving pulse from the color sensor
}

/******************************************************************************************************************************
* Function Name: colour_init
* Input:		 none
* Output:		 none
* Logic:		 initialse colour sensor
* Example call:	 colour_init();
*******************************************************************************************************************************/
void colour_init(void)
{
	color_sensor_pin_config();
	color_sensor_pin_interrupt_init();
	color_sensor_scaling();
	rgb_led_pin_config();
}

/******************************************************************************************************************************
* Function Name: filter_red
* Input:		 none
* Output:		 none
* Logic:		 Enables red filter
* Example call:	 filter_red();
*******************************************************************************************************************************/

void filter_red(void)    //Used to select red filter
{
	//Filter Select - red filter
	PORTD = PORTD & 0xBF; //set S2 low
	PORTD = PORTD & 0x7F; //set S3 low
}

/******************************************************************************************************************************
* Function Name: filter_green
* Input:		 none
* Output:		 none
* Logic:		 Enables green filter
* Example call:	 filter_green();
*******************************************************************************************************************************/

void filter_green(void)	//Used to select green filter
{
	//Filter Select - green filter
	PORTD = PORTD | 0x40; //set S2 High
	PORTD = PORTD | 0x80; //set S3 High
}

/******************************************************************************************************************************
* Function Name: filter_blue
* Input:		 none
* Output:		 none
* Logic:		 Enables blue filter
* Example call:	 filter_blue();
*******************************************************************************************************************************/

void filter_blue(void)	//Used to select blue filter
{
	//Filter Select - blue filter
	PORTD = PORTD & 0xBF; //set S2 low
	PORTD = PORTD | 0x80; //set S3 High
}

/******************************************************************************************************************************
* Function Name: filter_clear
* Input:		 none
* Output:		 none
* Logic:		 clear all filter
* Example call:	 filter_clear();
*******************************************************************************************************************************/

void filter_clear(void)	//select no filter
{
	//Filter Select - no filter
	PORTD = PORTD | 0x40; //set S2 High
	PORTD = PORTD & 0x7F; //set S3 Low
}

/******************************************************************************************************************************
* Function Name: color_sensor_scaling
* Input:		 none
* Output:		 none
* Logic:		 scales the colour sensor output frequency
* Example call:	 color_sensor_scaling();
*******************************************************************************************************************************/

void color_sensor_scaling()		//This function is used to select the scaled down version of the original frequency of the output generated by the color sensor, generally 20% scaling is preferable, though you can change the values as per your application by referring datasheet
{
	//Output Scaling 20% from datasheet
	//PORTD = PORTD & 0xEF;
	PORTD = PORTD | 0x10; //set S0 high
	//PORTD = PORTD & 0xDF; //set S1 low
	PORTD = PORTD | 0x20; //set S1 high
}

/******************************************************************************************************************************
* Function Name: red_read
* Input:		 none
* Output:		 none
* Logic:		 read red pulses
* Example call:	 red_read();
*******************************************************************************************************************************/

void red_read(void) // function to select red filter and display the count generated by the sensor on LCD. The count will be more if the color is red. The count will be very less if its blue or green.
{
	//Red
	filter_red(); //select red filter
	pulse=0; //reset the count to 0
	_delay_ms(10); //capture the pulses for 100 ms or 0.1 second
	red = pulse;  //store the count in variable called red
	
}

/******************************************************************************************************************************
* Function Name: green_read
* Input:		 none
* Output:		 none
* Logic:		 read green pulses
* Example call:	 green_read();
*******************************************************************************************************************************/

void green_read(void) // function to select green filter and display the count generated by the sensor on LCD. The count will be more if the color is green. The count will be very less if its blue or red.
{
	//Green
	filter_green(); //select green filter
	pulse=0; //reset the count to 0
	_delay_ms(10); //capture the pulses for 100 ms or 0.1 second
	green = pulse;  //store the count in variable called green
	
}

/******************************************************************************************************************************
* Function Name: blue_read
* Input:		 none
* Output:		 none
* Logic:		 read blue pulses
* Example call:	 blue_read();
*******************************************************************************************************************************/

void blue_read(void) // function to select blue filter and display the count generated by the sensor on LCD. The count will be more if the color is blue. The count will be very less if its red or green.
{
	//Blue
	filter_blue(); //select blue filter
	pulse=0; //reset the count to 0
	_delay_ms(10); //capture the pulses for 100 ms or 0.1 second
	blue = pulse;  //store the count in variable called blue
	
}

/******************************************************************************************************************************
* Function Name: no_filter
* Input:		 none
* Output:		 none
* Logic:		 read white pulses
* Example call:	 no_filter();
*******************************************************************************************************************************/

void no_filter()
{
	filter_clear(); //select clear filter
	pulse=0; //reset the count to 0
	_delay_ms(100); //capture the pulses for 100 ms or 0.1 second
	no_ff = (pulse);  //store the count in variable called blue

}

/******************************************************************************************************************************
* Function Name: get_colour
* Input:		 none
* Output:		 colour detected(0-RED, 1-GREEN, 2-Blue, 3-NO COLOUR)
* Logic:		 Detects the colour of the object(surviovor)
* Example call:	 get_colour();
*******************************************************************************************************************************/

int get_colour(void)
{
	EIMSK = EIMSK | 0x04;

    red_read(); //display the pulse count when red filter is selected
	_delay_ms(50);
	//lcd_print(1,4,red,4);
	green_read(); //display the pulse count when green filter is selected
	_delay_ms(50);
	//lcd_print(1,9,green,4);
	blue_read(); //display the pulse count when blue filter is selected
	_delay_ms(50); 
	//lcd_print(2,1,blue,4);
	no_filter();//display the pulse count when no filter is selected
	_delay_ms(50);
	//lcd_print(2,6,red,4);
	EIMSK = EIMSK & 0xFB;
	int a=(red+blue+green)/3;
	   
	if(a<250)
		return 3;
	else
	{
		if(red > blue && red > green)
			return 0;
		else if(green > red && green > blue)
			return 1;		
	}
	return 3;
}

/*
*	RED		- pin 45 : PJ0
*	Green	- pin 46 : PJ1
*	Blue	- pin 43 : PJ2
*/

/******************************************************************************************************************************
* Function Name: display_colour
* Input:		 c (colour to be displayed 0-RED, 1-GREEN, 2-Blue, 3-NO COLOUR)
* Output:		 none
* Logic:		 Turns on specified Colour of RGB LED
* Example call:	 display_colour();
*******************************************************************************************************************************/

void display_colour(int c)
{
	//unsigned char a;
	
	switch(c)
	{
		case 0:
		PORTJ = 0x01;break;
		
		case 1:
		PORTJ = 0x02;break;
		
		case 2:
		PORTJ = 0x04;break;
		
		default:
		case 3:
		PORTJ = 0x00;
		break;
	}
}

#endif